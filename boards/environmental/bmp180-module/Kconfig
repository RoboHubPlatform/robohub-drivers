## boards/environmental/bmp180-module/Kconfig
```kconfig
menu "RoboHub BMP180 module"

config RH_BOARD_BMP180_MODULE
    bool "BMP180 temperature, pressure and altitude sensor breakout"
    select RH_DRV_BMP180
    default n
    help
      The Bosch BMP180 sensor breakout. Selecting it brings in the driver and
      the bus and timer the breakout needs; an application that does not fit the
      module pays for none of it.

endmenu
```

## boards/environmental/dht11-module/Kconfig
```kconfig
menu "RoboHub DHT11 module"

config RH_BOARD_DHT11_MODULE
    bool "DHT11 temperature and humidity sensor breakout"
    select RH_DRV_DHT11
    default n
    help
      The DHT11 temperature and humidity sensor breakout. Selecting it brings in
      the driver and the single-wire line and timer the breakout needs; an
      application that does not fit the module pays for none of it.

endmenu
```

## boards/environmental/ky-015-temperature-humidity-sensor-module/Kconfig
```kconfig
menu "RoboHub ky-015-temperature-humidity-sensor module"

config RH_BOARD_KY_015_TEMPERATURE_HUMIDITY_SENSOR_MODULE
    bool "ky-015-temperature-humidity-sensor eval board"
    select RH_DRV_DHT11
    default n
    help
      A KY-015 temperature and humidity sensor: a DHT11 on a single-wire bus.

endmenu
```

## boards/input/ky-002-vibration-switch-module/Kconfig
```kconfig
menu "RoboHub ky-002-vibration-switch module"

config RH_BOARD_KY_002_VIBRATION_SWITCH_MODULE
    bool "ky-002-vibration-switch eval board"
    select RH_DRV_BUTTON_GPIO
    default n
    help
      A KY-002 vibration switch on a GPIO.

endmenu
```

## boards/input/ky-003-hall-magnetic-sensor-module/Kconfig
```kconfig
menu "RoboHub ky-003-hall-magnetic-sensor module"

config RH_BOARD_KY_003_HALL_MAGNETIC_SENSOR_MODULE
    bool "ky-003-hall-magnetic-sensor eval board"
    select RH_DRV_BUTTON-GPIO
    default n
    help
      A KY-003 hall magnetic sensor: a solid-state switch that is polarity sensitive.

endmenu
```

## boards/input/ky-004-key-switch-module/Kconfig
```kconfig
menu "RoboHub ky-004-key-switch module"

config RH_BOARD_KY_004_KEY_SWITCH_MODULE
    bool "ky-004-key-switch eval board"
    select RH_DRV_BUTTON-GPIO
    default n
    help
      A KY-004 key switch: a push-button on a GPIO.

endmenu
```

## boards/input/ky-010-photo-interrupter-module/Kconfig
```kconfig
menu "RoboHub ky-010-photo-interrupter module"

config RH_BOARD_KY_010_PHOTO_INTERRUPTER_MODULE
    bool "ky-010-photo-interrupter eval board"
    select RH_DRV_BUTTON-GPIO
    default n
    help
      A KY-010 photo interrupter: a light barrier whose output changes when the beam is broken.

endmenu
```

## boards/input/ky-017-mercury-switch-module/Kconfig
```kconfig
menu "RoboHub ky-017-mercury-switch module"

config RH_BOARD_KY_017_MERCURY_SWITCH_MODULE
    bool "ky-017-mercury-switch eval board"
    select RH_DRV_BUTTON_GPIO
    default n
    help
      A KY-017 mercury switch: a tilting contact on a GPIO.

endmenu
```

## boards/input/ky-020-tilt-switch-module/Kconfig
```kconfig
menu "RoboHub ky-020-tilt-switch module"

config RH_BOARD_KY_020_TILT_SWITCH_MODULE
    bool "ky-020-tilt-switch eval board"
    select RH_DRV_BUTTON_GPIO
    default n
    help
      A KY-020 tilt switch: a ball switch on a GPIO.

endmenu
```

## boards/input/ky-021-mini-magnetic-reed-switch-module/Kconfig
```kconfig
menu "RoboHub ky-021-mini-magnetic-reed-switch module"

config RH_BOARD_KY_021_MINI_MAGNETIC_REED_SWITCH_MODULE
    bool "ky-021-mini-magnetic-reed-switch eval board"
    select RH_DRV_BUTTON-GPIO
    default n
    help
      A KY-021 mini magnetic reed switch: a normally open contact that reads low when a magnet is near.

endmenu
```

## boards/input/ky-022-infrared-receiver-module/Kconfig
```kconfig
menu "RoboHub ky-022-infrared-receiver module"

config RH_BOARD_KY_022_INFRARED_RECEIVER_MODULE
    bool "ky-022-infrared-receiver eval board"
    select RH_DRV_INFRARED-RECEIVER-GPIO
    default n
    help
      A KY-022 infrared receiver: it hears the codes a remote sends.

endmenu
```

## boards/input/ky-023-joystick-dual-axis-module/Kconfig
```kconfig
menu "RoboHub ky-023-joystick-dual-axis module"

config RH_BOARD_KY_023_JOYSTICK_DUAL_AXIS_MODULE
    bool "ky-023-joystick-dual-axis eval board"
    select RH_DRV_ANALOG_ADC
    select RH_DRV_BUTTON_GPIO
    default n
    help
      A KY-023 dual-axis joystick: two potentiometers and a push switch.

endmenu
```

## boards/input/ky-024-linear-magnetic-hall-module/Kconfig
```kconfig
menu "RoboHub ky-024-linear-magnetic-hall module"

config RH_BOARD_KY_024_LINEAR_MAGNETIC_HALL_MODULE
    bool "ky-024-linear-magnetic-hall eval board"
    select RH_DRV_ANALOG-ADC
    default n
    help
      A KY-024 linear magnetic hall sensor: the field it sees as a voltage.

endmenu
```

## boards/input/ky-025-reed-switch-module/Kconfig
```kconfig
menu "RoboHub ky-025-reed-switch module"

config RH_BOARD_KY_025_REED_SWITCH_MODULE
    bool "ky-025-reed-switch eval board"
    select RH_DRV_ANALOG-ADC
    default n
    help
      A KY-025 reed switch: a digital contact and an analog output of the field strength.

endmenu
```

## boards/input/ky-026-flame-sensor-module/Kconfig
```kconfig
menu "RoboHub ky-026-flame-sensor module"

config RH_BOARD_KY_026_FLAME_SENSOR_MODULE
    bool "ky-026-flame-sensor eval board"
    select RH_DRV_ANALOG-ADC
    default n
    help
      A KY-026 flame sensor: the flame it sees as a voltage.

endmenu
```

## boards/input/ky-031-knock-sensor-module/Kconfig
```kconfig
menu "RoboHub ky-031-knock-sensor module"

config RH_BOARD_KY_031_KNOCK_SENSOR_MODULE
    bool "ky-031-knock-sensor eval board"
    select RH_DRV_BUTTON_GPIO
    default n
    help
      A KY-031 knock sensor: a piezo knock contact on a GPIO.

endmenu
```

## boards/input/ky-032-infrared-obstacle-avoidance-sensor-module/Kconfig
```kconfig
menu "RoboHub ky-032-infrared-obstacle-avoidance-sensor module"

config RH_BOARD_KY_032_INFRARED_OBSTACLE_AVOIDANCE_SENSOR_MODULE
    bool "ky-032-infrared-obstacle-avoidance-sensor eval board"
    select RH_DRV_BUTTON-GPIO
    default n
    help
      A KY-032 infrared obstacle-avoidance sensor: it says whether something is in front of it.

endmenu
```

## boards/input/ky-033-line-tracking-sensor-module/Kconfig
```kconfig
menu "RoboHub ky-033-line-tracking-sensor module"

config RH_BOARD_KY_033_LINE_TRACKING_SENSOR_MODULE
    bool "ky-033-line-tracking-sensor eval board"
    select RH_DRV_BUTTON-GPIO
    default n
    help
      A KY-033 line-tracking sensor: one reflective detector that says whether it is over a dark line.

endmenu
```

## boards/input/ky-035-analog-hall-magnetic-sensor-module/Kconfig
```kconfig
menu "RoboHub ky-035-analog-hall-magnetic-sensor module"

config RH_BOARD_KY_035_ANALOG_HALL_MAGNETIC_SENSOR_MODULE
    bool "ky-035-analog-hall-magnetic-sensor eval board"
    select RH_DRV_ANALOG-ADC
    default n
    help
      A KY-035 analog hall sensor: the field it sees as a voltage.

endmenu
```

## boards/input/ky-036-metal-touch-sensor-module/Kconfig
```kconfig
menu "RoboHub ky-036-metal-touch-sensor module"

config RH_BOARD_KY_036_METAL_TOUCH_SENSOR_MODULE
    bool "ky-036-metal-touch-sensor eval board"
    select RH_DRV_BUTTON-GPIO
    default n
    help
      A KY-036 metal-touch sensor: a capacitive pad that says when it is touched.

endmenu
```

## boards/input/ky-037-microphone-sound-sensor-module/Kconfig
```kconfig
menu "RoboHub ky-037-microphone-sound-sensor module"

config RH_BOARD_KY_037_MICROPHONE_SOUND_SENSOR_MODULE
    bool "ky-037-microphone-sound-sensor eval board"
    select RH_DRV_ANALOG-ADC
    default n
    help
      A KY-037 microphone sound sensor: the sound at the microphone as a level.

endmenu
```

## boards/input/ky-038-microphone-sound-sensor-module/Kconfig
```kconfig
menu "RoboHub ky-038-microphone-sound-sensor module"

config RH_BOARD_KY_038_MICROPHONE_SOUND_SENSOR_MODULE
    bool "ky-038-microphone-sound-sensor eval board"
    select RH_DRV_ANALOG-ADC
    default n
    help
      A KY-038 microphone sound sensor: the sound at the microphone as a level.

endmenu
```

## boards/input/ky-039-heartbeat-sensor-module/Kconfig
```kconfig
menu "RoboHub ky-039-heartbeat-sensor module"

config RH_BOARD_KY_039_HEARTBEAT_SENSOR_MODULE
    bool "ky-039-heartbeat-sensor eval board"
    select RH_DRV_PULSE-ADC
    default n
    help
      A KY-039 heartbeat sensor: a phototransistor that follows the pulse of blood.

endmenu
```

## boards/input/ky-040-rotary-encoder-module/Kconfig
```kconfig
menu "RoboHub ky-040-rotary-encoder module"

config RH_BOARD_KY_040_ROTARY_ENCODER_MODULE
    bool "ky-040-rotary-encoder eval board"
    select RH_DRV_ENCODER-GPIO
    default n
    help
      A KY-040 rotary encoder: a knob that turns, with a push switch of its own.

endmenu
```

## boards/light/ky-018-photoresistor-module/Kconfig
```kconfig
menu "RoboHub ky-018-photoresistor module"

config RH_BOARD_KY_018_PHOTORESISTOR_MODULE
    bool "ky-018-photoresistor eval board"
    select RH_DRV_PHOTORESISTOR-ADC
    default n
    help
      A KY-018 photoresistor on an ADC channel.

endmenu
```
