## boards/environmental/sht4x-module/Kconfig
```kconfig
menu "RoboHub SHT4x module"

config RH_BOARD_SHT4X_MODULE
    bool "SHT4x temperature and humidity sensor breakout"
    select RH_DRV_SHT4X
    default n
    help
      An SHT40, SHT41 or SHT45 breakout on I2C (robohub ADR-0026). Selecting it
      brings in the driver and the I2C bus and timer it needs; an application
      that does not fit the module pays for none of it.

endmenu
```

## drivers/environmental/sht4x/Kconfig
```kconfig
menu "RoboHub SHT4x driver"

config RH_DRV_SHT4X
    bool "SHT4x temperature and humidity sensor"
    select RH_HAL_I2C
    select RH_HAL_TIMER
    default n
    help
      Sensirion's SHT40, SHT41 and SHT45 temperature and humidity sensors,
      reached through the I2C HAL and a timer the selected platform implements
      (robohub ADR-0026). An application that sets this gets the driver compiled
      in; one that does not pays for none of it.

endmenu
```
