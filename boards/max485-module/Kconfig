## boards/max485-module/Kconfig
```kconfig
menu "RoboHub MAX485 module"

config RH_BOARD_MAX485_MODULE
    bool "MAX485 RS485 transceiver carrier"
    select RH_HAL_RS485
    select RH_HAL_UART
    select RH_HAL_GPIO
    select RH_HAL_TIMER
    default n
    help
      A MAX485 RS485 transceiver carrier, bound to a UART and a direction pin.
      Selecting it makes the RoboHubRS485 interface available on a board that
      does not carry RS485 natively; the pins and speed are given when the
      module is brought up.

endmenu
```

## boards/output/ky-005-ir-transmitter-module/Kconfig
```kconfig
menu "RoboHub ky-005-ir-transmitter module"

config RH_BOARD_KY_005_IR_TRANSMITTER_MODULE
    bool "ky-005-ir-transmitter eval board"
    select RH_DRV_INFRARED-PWM
    default n
    help
      A KY-005 infrared transmitter on a PWM channel.

endmenu
```

## boards/output/ky-006-passive-buzzer-module/Kconfig
```kconfig
menu "RoboHub ky-006-passive-buzzer module"

config RH_BOARD_KY_006_PASSIVE_BUZZER_MODULE
    bool "ky-006-passive-buzzer eval board"
    select RH_DRV_TONE-PWM
    default n
    help
      A KY-006 passive buzzer on a PWM channel.

endmenu
```

## boards/output/ky-008-laser-transmitter-module/Kconfig
```kconfig
menu "RoboHub ky-008-laser-transmitter module"

config RH_BOARD_KY_008_LASER_TRANSMITTER_MODULE
    bool "ky-008-laser-transmitter eval board"
    select RH_DRV_GPIO-SWITCH
    default n
    help
      A KY-008 laser transmitter: a diode you light by driving its signal.

endmenu
```

## boards/output/ky-009-rgb-led-module/Kconfig
```kconfig
menu "RoboHub ky-009-rgb-led module"

config RH_BOARD_KY_009_RGB_LED_MODULE
    bool "ky-009-rgb-led eval board"
    select RH_DRV_RGB-PWM
    default n
    help
      A KY-009 RGB full-colour LED on three PWM channels.

endmenu
```

## boards/output/ky-011-two-color-led-module/Kconfig
```kconfig
menu "RoboHub ky-011-two-color-led module"

config RH_BOARD_KY_011_TWO_COLOR_LED_MODULE
    bool "ky-011-two-color-led eval board"
    select RH_DRV_RGB_PWM
    default n
    help
      A KY-011 two-colour LED on two PWM channels.

endmenu
```

## boards/output/ky-012-active-buzzer-module/Kconfig
```kconfig
menu "RoboHub ky-012-active-buzzer module"

config RH_BOARD_KY_012_ACTIVE_BUZZER_MODULE
    bool "ky-012-active-buzzer eval board"
    select RH_DRV_GPIO-SWITCH
    default n
    help
      A KY-012 active buzzer: it has its own oscillator, so it is driven on and off rather than at a frequency.

endmenu
```

## boards/output/ky-016-rgb-full-color-led-module/Kconfig
```kconfig
menu "RoboHub ky-016-rgb-full-color-led module"

config RH_BOARD_KY_016_RGB_FULL_COLOR_LED_MODULE
    bool "ky-016-rgb-full-color-led eval board"
    select RH_DRV_RGB_PWM
    default n
    help
      A KY-016 RGB full-colour LED (SMD, four pins) on three PWM channels.

endmenu
```

## boards/output/ky-019-5v-relay-module/Kconfig
```kconfig
menu "RoboHub ky-019-5v-relay module"

config RH_BOARD_KY_019_5V_RELAY_MODULE
    bool "ky-019-5v-relay eval board"
    select RH_DRV_GPIO-SWITCH
    default n
    help
      A KY-019 5V relay: one channel that switches a load. It is active-HIGH — the relay pulls in when the signal is high, the opposite of the blue optocoupler boards.

endmenu
```

## boards/output/ky-027-magic-light-cup-module/Kconfig
```kconfig
menu "RoboHub ky-027-magic-light-cup module"

config RH_BOARD_KY_027_MAGIC_LIGHT_CUP_MODULE
    bool "ky-027-magic-light-cup eval board"
    select RH_DRV_GPIO-SWITCH
    default n
    help
      A KY-027 magic light cup: a mercury tilt switch and an LED on one small board, sold as a pair.

endmenu
```

## boards/output/ky-029-dual-color-led-module/Kconfig
```kconfig
menu "RoboHub ky-029-dual-color-led module"

config RH_BOARD_KY_029_DUAL_COLOR_LED_MODULE
    bool "ky-029-dual-color-led eval board"
    select RH_DRV_RGB_PWM
    default n
    help
      A KY-029 dual-colour LED on two PWM channels.

endmenu
```

## boards/output/ky-034-automatic-flashing-color-led-module/Kconfig
```kconfig
menu "RoboHub ky-034-automatic-flashing-color-led module"

config RH_BOARD_KY_034_AUTOMATIC_FLASHING_COLOR_LED_MODULE
    bool "ky-034-automatic-flashing-color-led eval board"
    select RH_DRV_GPIO-SWITCH
    default n
    help
      A KY-034 seven-colour self-flashing LED: the sequence is inside the LED, so it is switched on and off as a whole.

endmenu
```

## boards/temperature/ds18b20-temperature-module/Kconfig
```kconfig
menu "RoboHub DS18B20 module"

config RH_BOARD_DS18B20_MODULE
    bool "DS18B20 temperature sensor breakout"
    select RH_DRV_DS18B20
    default n
    help
      The DS18B20 temperature sensor breakout. Selecting it brings in the
      driver and the 1-Wire bus and timer the breakout needs; an application
      that does not fit the module pays for none of it.

endmenu
```

## boards/temperature/ds18b20-waterproof-probe-module/Kconfig
```kconfig
menu "RoboHub DS18B20 waterproof probe"

config RH_BOARD_DS18B20_WATERPROOF_PROBE
    bool "DS18B20 waterproof temperature probe"
    select RH_DRV_DS18B20
    default n
    help
      A sealed DS18B20 temperature probe on a one-metre cable, for water,
      soil and ambient temperature. Selecting it brings in the driver and the
      1-Wire bus and timer the probe needs; an application that does not fit
      the probe pays for none of it.

endmenu
```

## boards/temperature/ky-001-temperature-sensor-module/Kconfig
```kconfig
menu "RoboHub ky-001-temperature-sensor module"

config RH_BOARD_KY_001_TEMPERATURE_SENSOR_MODULE
    bool "ky-001-temperature-sensor eval board"
    select RH_DRV_DS18B20
    default n
    help
      A KY-001 temperature sensor: a DS18B20 on a 1-Wire bus.

endmenu
```

## boards/temperature/ky-013-analog-temperature-sensor-module/Kconfig
```kconfig
menu "RoboHub ky-013-analog-temperature-sensor module"

config RH_BOARD_KY_013_ANALOG_TEMPERATURE_SENSOR_MODULE
    bool "ky-013-analog-temperature-sensor eval board"
    select RH_DRV_THERMISTOR-ADC
    default n
    help
      A KY-013 analog temperature sensor: a thermistor on an ADC channel.

endmenu
```

## boards/temperature/ky-028-digital-temperature-sensor-module/Kconfig
```kconfig
menu "RoboHub ky-028-digital-temperature-sensor module"

config RH_BOARD_KY_028_DIGITAL_TEMPERATURE_SENSOR_MODULE
    bool "ky-028-digital-temperature-sensor eval board"
    select RH_DRV_BUTTON-GPIO
    default n
    help
      A KY-028 digital temperature sensor: a thermistor and a comparator, which says when the temperature crosses the threshold its trimmer sets. Its analog output is a relative reading, not a temperature, so the threshold is the part that is used.

endmenu
```

## drivers/environmental/bmp180/Kconfig
```kconfig
menu "RoboHub BMP180 driver"

config RH_DRV_BMP180
    bool "BMP180 temperature, pressure and altitude sensor"
    select RH_HAL_I2C
    select RH_HAL_SPI
    select RH_HAL_TIMER
    default n
    help
      The Bosch BMP180 temperature, pressure and altitude sensor, reached
      through the common register bus and a timer the selected platform
      implements. An application that sets this gets the driver compiled in; one
      that does not pays for none of it.

endmenu
```

## drivers/environmental/dht11/Kconfig
```kconfig
menu "RoboHub DHT11 driver"

config RH_DRV_DHT11
    bool "DHT11 temperature and humidity sensor"
    select RH_HAL_DHT
    select RH_HAL_TIMER
    default n
    help
      The Aosong DHT11 temperature and humidity sensor, reached through the
      single-wire HAL and a timer the selected platform implements. An
      application that sets this gets the driver compiled in; one that does not
      pays for none of it.

endmenu
```

## drivers/input/analog-adc/Kconfig
```kconfig
menu "RoboHub robohub-driver-analog-adc"

config RH_DRV_ANALOG_ADC
    bool "robohub-driver-analog-adc"
    select RH_HAL_ADC
    default n
    help
      A input part presenting the analog interface.

endmenu
```

## drivers/input/button-gpio/Kconfig
```kconfig
menu "RoboHub robohub-driver-button-gpio"

config RH_DRV_BUTTON_GPIO
    bool "robohub-driver-button-gpio"
    select RH_HAL_GPIO\n    default n
    help
      A robohub-driver-button-gpio part.

endmenu
```

## drivers/input/encoder-gpio/Kconfig
```kconfig
menu "RoboHub robohub-driver-encoder-gpio"

config RH_DRV_ENCODER_GPIO
    bool "robohub-driver-encoder-gpio"
    select RH_HAL_GPIO
    default n
    help
      A input part presenting the encoder interface.

endmenu
```

## drivers/input/infrared-receiver-gpio/Kconfig
```kconfig
menu "RoboHub robohub-driver-infrared-receiver-gpio"

config RH_DRV_INFRARED_RECEIVER_GPIO
    bool "robohub-driver-infrared-receiver-gpio"
    select RH_HAL_GPIO
    select RH_HAL_TIMER
    default n
    help
      A input part presenting the infrared interface.

endmenu
```

## drivers/input/pulse-adc/Kconfig
```kconfig
menu "RoboHub robohub-driver-pulse-adc"

config RH_DRV_PULSE_ADC
    bool "robohub-driver-pulse-adc"
    select RH_HAL_ADC
    select RH_HAL_TIMER
    default n
    help
      A input part presenting the pulse interface.

endmenu
```

## drivers/light/photoresistor-adc/Kconfig
```kconfig
menu "RoboHub robohub-driver-photoresistor-adc"

config RH_DRV_PHOTORESISTOR_ADC
    bool "robohub-driver-photoresistor-adc"
    select RH_HAL_ADC\n    default n
    help
      A robohub-driver-photoresistor-adc part.

endmenu
```
