## drivers/output/gpio-switch/Kconfig
```kconfig
menu "RoboHub robohub-driver-gpio-switch"

config RH_DRV_GPIO_SWITCH
    bool "robohub-driver-gpio-switch"
    select RH_HAL_GPIO
    default n
    help
      A output part presenting the switch interface.

endmenu
```

## drivers/output/infrared-pwm/Kconfig
```kconfig
menu "RoboHub robohub-driver-infrared-pwm"

config RH_DRV_INFRARED_PWM
    bool "robohub-driver-infrared-pwm"
    select RH_HAL_PWM\n    select RH_HAL_TIMER\n    default n
    help
      A robohub-driver-infrared-pwm part.

endmenu
```

## drivers/output/rgb-pwm/Kconfig
```kconfig
menu "RoboHub robohub-driver-rgb-pwm"

config RH_DRV_RGB_PWM
    bool "robohub-driver-rgb-pwm"
    select RH_HAL_PWM\n    default n
    help
      A robohub-driver-rgb-pwm part.

endmenu
```

## drivers/output/tone-pwm/Kconfig
```kconfig
menu "RoboHub robohub-driver-tone-pwm"

config RH_DRV_TONE_PWM
    bool "robohub-driver-tone-pwm"
    select RH_HAL_PWM\n    default n
    help
      A robohub-driver-tone-pwm part.

endmenu
```

## drivers/temperature/ds18b20/Kconfig
```kconfig
menu "RoboHub DS18B20 driver"

config RH_DRV_DS18B20
    bool "DS18B20 1-Wire temperature sensor"
    select RH_HAL_ONEWIRE
    select RH_HAL_TIMER
    default n
    help
      The Maxim DS18B20 temperature sensor, reached through a 1-Wire bus and a
      timer the selected platform implements. An application that sets this
      gets the driver compiled in; one that does not pays for none of it.

endmenu
```

## drivers/temperature/thermistor-adc/Kconfig
```kconfig
menu "RoboHub robohub-driver-thermistor-adc"

config RH_DRV_THERMISTOR_ADC
    bool "robohub-driver-thermistor-adc"
    select RH_HAL_ADC
    default n
    help
      A temperature part presenting the temperature interface.

endmenu
```

## examples/environmental/bmp180/c/Kconfig
```kconfig
# bmp180 environmental example configuration

config RH_HAL_GPIO
    bool "GPIO"
    default y

config RH_HAL_UART
    bool "UART"
    default y

config RH_HAL_TIMER
    bool "Timer"
    default y

config RH_HAL_I2C
    bool "I2C"
    default y

config RH_BOARD_PICO_2W
    bool "Pico 2W"
    default y

config RH_BOARD_BMP180_MODULE
    bool "BMP180 sensor module"
    default y
```

## examples/environmental/dht11/rho/Kconfig
```kconfig
# dht11 environmental example configuration

config RH_HAL_GPIO
    bool "GPIO"
    default y

config RH_HAL_UART
    bool "UART"
    default y

config RH_HAL_TIMER
    bool "Timer"
    default y

config RH_HAL_DHT
    bool "DHT single-wire"
    default y

config RH_BOARD_PICO_2W
    bool "Pico 2W"
    default y

config RH_BOARD_DHT11_MODULE
    bool "DHT11 sensor module"
    default y
```

## examples/gateway/c/relay/Kconfig
```kconfig
# gateway/c/relay configuration

config RH_HAL_GPIO
    bool "GPIO"
    default y

config RH_HAL_UART
    bool "UART"
    default y

config RH_HAL_TIMER
    bool "Timer"
    default y

config RH_BOARD_PICO_2W
    bool "Pico 2W"
    default y

config RH_TRANSPORT
    bool "Transport"
    default y

config RH_TELEMETRY
    bool "Telemetry"
    default y

config RH_NET
    bool "Network"
    default y

# The area this relay speaks for: the area the boards behind it are numbered in.
config RH_AREA_ID
    int "Area id"
    range 1 65535
    default 1
```

## examples/temperature/ds18b20/c/freertos/Kconfig
```kconfig
# ds18b20 temperature example configuration

config RH_HAL_GPIO
    bool "GPIO"
    default y

config RH_HAL_UART
    bool "UART"
    default y

config RH_HAL_TIMER
    bool "Timer"
    default y

config RH_HAL_ONEWIRE
    bool "OneWire"
    default y

config RH_BOARD_PICO_2W
    bool "Pico 2W"
    default y

config RH_BOARD_DS18B20_MODULE
    bool "DS18B20 temperature module"
    default y

config RH_FREERTOS
    bool "FreeRTOS OSAL"
    default y
```

## templates/board/Kconfig
```kconfig
menu "RoboHub {{name}} module"

config RH_BOARD_{{name}}_MODULE
    bool "{{name}} eval board"
    select RH_DRV_{{name}}
    default n
    help
      The {{name}} eval board. Selecting it brings in the driver and the bus
      the board needs; an application that does not fit the board pays for none
      of it.

endmenu
```

## templates/driver/Kconfig
```kconfig
menu "RoboHub {{name}} driver"

config RH_DRV_{{name}}
    bool "{{description}}"
    default n
    help
      An application that sets this gets the driver compiled in; one that does
      not pays for none of it.

endmenu
```
